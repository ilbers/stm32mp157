## meta-stm32/conf/layer.conf
```bitbake
# Copyright (C) 2024 ilbers GmbH

BBPATH .= ":${LAYERDIR}"
BBFILES += "${LAYERDIR}/recipes-*/*/*.bb ${LAYERDIR}/recipes-*/*/*.bbappend"

LAYERDIR_stm32 = "${LAYERDIR}"
```

## meta-stm32/conf/machine/stm32mp157.conf
```bitbake
# Copyright (C) 2024 ilbers GmbH

DISTRO_ARCH ?= "armhf"

IMAGE_FSTYPES ?= "tar.gz"
```
